## boards/shields/MACROPAD/Kconfig.defconfig
```kconfig
# Copyright (c) 2022 The ZMK Contributors
# SPDX-License-Identifier: MIT

if SHIELD_MACROPAD

config ZMK_KEYBOARD_NAME
    default "Macropad"

endif
```
